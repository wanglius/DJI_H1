## components/clock_sync/Kconfig
```kconfig
menu "DJI H1 timekeeping"

config DJI_H1_TIMEZONE_NAME
    string "Mission local timezone name"
    default "Asia/Shanghai"
    help
        Human-readable IANA-style label recorded in MISSION.JSON. The label is
        metadata only; the numeric UTC offset below controls conversion.

config DJI_H1_TIMEZONE_OFFSET_MINUTES
    int "Mission local offset from UTC (minutes)"
    range -720 840
    default 480
    help
        Fixed civil-time offset recorded with each mission and operation event.
        Positive values are east of UTC. The default 480 is UTC+08:00 for
        Shanghai and Beijing. Scientific record timestamps remain Unix UTC.

endmenu
```

## components/measurement_recorder/Kconfig
```kconfig
menu "DJI H1 measurement recorder"

config DJI_H1_TEST_FAULT_INJECTION
    bool "Enable measurement-recorder fault injection"
    default n
    help
        Unlock test-only recorder fault injection. Never enable this option in
        a production image.

config DJI_H1_TEST_ONESHOT_FLUSH_STALL_MS
    int "TEST ONLY: one-shot SD flush stall (milliseconds)"
    range 0 30000
    default 0
    depends on DJI_H1_TEST_FAULT_INJECTION
    help
        Inject one delay before the first active flush to exercise bounded
        recorder backpressure. The firmware prints a boot warning when this is
        nonzero. Keep fault injection disabled in every production build.

endmenu
```

## components/startup_checks/Kconfig
```kconfig
config DJI_H1_BOOT_SELF_TESTS
    bool "Run deterministic qualification checks at boot"
    default n
    help
        Compile and run the protocol, record-pipeline, clock, calculation, and
        telemetry transport self-tests before production services start.
        Enable for qualification firmware; leave disabled in flight images to
        reduce boot time and keep test-only code out of the binary.
```

## components/telemetry/Kconfig
```kconfig
menu "DJI H1 telemetry"

config DJI_H1_TELEMETRY_TIMING_DIAGNOSTICS
    bool "Emit detailed telemetry transmission timing"
    default y
    help
        Emit one TX_TIMING line per transmission attempt and one ACK_TIMING
        line per accepted application acknowledgement. Keep this enabled for
        development and field qualification; disable it in a quiet production
        image to reduce USB-console CPU and log volume.

endmenu
```

## tests/hardware_diagnostics/main/Kconfig.projbuild
```kconfig
choice DJI_H1_HARDWARE_DIAGNOSTIC
    prompt "Hardware diagnostic to run"
    default DJI_H1_DIAGNOSTIC_SD_CARD

    config DJI_H1_DIAGNOSTIC_SD_CARD
        bool "Destructive SD-card connection/readback test"

    config DJI_H1_DIAGNOSTIC_COEXISTENCE
        bool "Dual-spectrometer and SD-card coexistence test"
endchoice

config DJI_H1_DIAGNOSTIC_DURATION_MS
    int "Coexistence test duration (milliseconds)"
    range 1000 3600000
    default 30000
    depends on DJI_H1_DIAGNOSTIC_COEXISTENCE
```
